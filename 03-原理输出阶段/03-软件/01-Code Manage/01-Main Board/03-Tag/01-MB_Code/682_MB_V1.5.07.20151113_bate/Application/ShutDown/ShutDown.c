/*
*******************************************************************************
*                  深圳市安保科技有限公司开发部                     
*                      Ambulanc Tech Co., Ltd                       
*            Copyright (C) 2009, All Rights Reserved                
*                                                                   
* 模块名称: ShutDwon.c
* 摘    要: 电源关机模块程序
*
* 当前版本: 1.0
* 作    者: 曾健    
* 完成日期: 2015-09-01
* 内    容:
* 注    意: none                                                                  
*******************************************************************************
* 取代版本: 
* 作    者:
* 完成日期: 
* 修改内容:
* 修改文件: 
*******************************************************************************
*/
/*
*******************************************************************************
*                               包含头文件
*******************************************************************************
*/
#include "includes.h"
#include "ShutDown.h"
#include "KeyApp.h"
#include "K096.h"
#include "Alarm.h"
#include "Monitor.h"
#include "DataSamp.h"
/*
********************************************************************************
*                               宏定义
********************************************************************************
*/
/*
********************************************************************************
*                               类型定义
********************************************************************************
*/
/*
********************************************************************************
*                               内部变量
********************************************************************************
*/
/*      一段时间内按键连续按下的次数     */
static INT32U      m_ShKeyNum = 0;
/*      进入关机状态的标志       */
static BOOLEAN     m_ShFlag = DEF_SHUTDOWN_OFF;
/*      报警表        */
static ALARM_Table m_ShAlarmTable;
/*
********************************************************************************
********************************************************************************
*                               内部函数
********************************************************************************
********************************************************************************
*/
/*
******************************************************************************
函数名称:   SHUTDOWN_Alarm
函数功能:   关闭气道压和氧浓度的报警
输入参数:   none
输出参数:   none
返 回 值:   none
创建日期:   2015-09-01
注    意:   none
*******************************************************************************
*/
static void SHUTDOWN_Alarm(void)
{
     /*设置报警表中各报警值为0，表示没有报警*/
     m_ShAlarmTable.FiO2_High_Alarm = 0;
     m_ShAlarmTable.FiO2_Low_Alarm = 0;
     m_ShAlarmTable.Paw_High_Alarm = 0;
     m_ShAlarmTable.Paw_Low_Alarm = 0;
     m_ShAlarmTable.Bat_Red_Alarm = 0;
     ALARM_Write(m_ShAlarmTable);
}
/*
******************************************************************************
函数名称:   SHUTDOWN_ShutDown
函数功能:   关闭各路电源
输入参数:   none
输出参数:   none
返 回 值:   none
创建日期:   2015-09-01
注    意:   none
*******************************************************************************
*/
static void SHUTDOWN_ShutDown(void)
{
    /*关闭各路电源*/
    POWER_SwitchSet(DEF_EN_DC, DEF_POWER_CLOSE);
    POWER_SwitchSet(DEF_DC_DC, DEF_POWER_CLOSE);
    POWER_SwitchSet(DEF_ON_STABLE, DEF_POWER_CLOSE);
    
    /*      硬件复位        */
	NVIC_GenerateSystemReset();   
}
/*
********************************************************************************
********************************************************************************
*                               接口函数
********************************************************************************
********************************************************************************
*/
/*
******************************************************************************
函数名称:   SHUTDOWN_Doing
函数功能:   关机任务
输入参数:   none
输出参数:   none
返 回 值:   none
创建日期:   2015-09-01
注    意:   none
*******************************************************************************
*/
void SHUTDOWN_Exec(void)
{    
    /*      监测报警静音键的按下      */   
    if(KEY_Scan() == DEF_KEY_CODE_PPOWER_SWITCH)
    {
        /*轮循一个周期，就加1，当连续10个周期都是按着，就进入关机*/
        m_ShKeyNum++;
        
        if(m_ShKeyNum >=10)
        {            
            m_ShFlag = DEF_SHUTDOWN_ON;
            SHUTDOWN_Alarm();
            OSTimeDlyHMSM(0, 0, 0, 100);
            /*      关闭氧浓度，报警静音，气道压的灯        */
            LCD_Clear();
            LCD_Clear();
            LCD_Clear();
            LED_Set(DEF_LED_HIGH_FIO2, DEF_LED_CLOSE);
            LED_Set(DEF_LED_LOW_FIO2, DEF_LED_CLOSE);
            LED_Set(DEF_LED_ALARM_SOUND, DEF_LED_CLOSE);
            GPIO_ResetBits(DEF_CTR_PRE_LED_PORT, DEF_CTR_PRE_LED_PIN);          
        }
    }    
    else
    {
        /*      中间间断一个周期没监测到关机按键按下，就让m_ShKeyNum置0       */
        m_ShKeyNum = 0;
    }
    
    /*      按键弹起之后再真正关机     */
    if(1 == m_ShFlag)
    {
        if(KEYAPP_Takeoff(DEF_KEY_CODE_PPOWER_SWITCH) == 1)
        {
            SHUTDOWN_ShutDown();
        }
    }
    OSTimeDlyHMSM(0, 0, 0, 100);
}
/*
******************************************************************************
函数名称:   SHUTDOWN_Is
函数功能:   获取关机标志
输入参数:   none
输出参数:   none
返 回 值:   返回1表示关机了， 0表示没关机。
创建日期:   2015-09-01
注    意:   none
*******************************************************************************
*/
INT8U SHUTDOWN_Is(void)
{    
    return m_ShFlag;
}