/*
*******************************************************************************
*                  深圳市安保科技有限公司开发部                     
*                      Ambulanc Tech Co., Ltd                       
*            Copyright (C) 2009, All Rights Reserved                
*                                                                   
* 模块名称: Display.c
* 摘    要: 显示模块程序
*
* 当前版本: 1.0
* 作    者: 曾健
* 完成日期: 2015-09-10
* 内    容:
* 注    意: none                                                                  
*******************************************************************************
* 取代版本: 
* 作    者:
* 完成日期: 
* 修改内容:
* 修改文件: 
*******************************************************************************
*/
/*
*******************************************************************************
*                               包含头文件
*******************************************************************************
*/
#include "includes.h"
#include "Calibration.h"
#include "Display.h"
#include "ShutDown.h"
#include "StartingUp.h"
#include "K096.h"
#include "Monitor.h"
/*
********************************************************************************
*                               宏定义
********************************************************************************
*/
/*
********************************************************************************
*                               类型定义
********************************************************************************
*/
/*
********************************************************************************
*                               内部变量
********************************************************************************
*/
/*      氧浓度、气道压值的保存     */
static INT8U m_DiFiO2Value = 0;
static INT8U m_DiPawValue = 0;
/*      氧浓度值的标志     */
static INT8U m_DiFiO2Valueflag = 0;
/*      校准标志        */
static INT8U m_DiAdjFlag = DEF_CAL_OFF;
/*      记录第一次，在第一次显示氧浓度时，清屏一下        */
static INT8U m_DiOneFlag = 0;
/*
********************************************************************************
********************************************************************************
*                               内部函数
********************************************************************************
********************************************************************************
*/
/*
******************************************************************************
函数名称:   DISPLAY_GETValue
函数功能:   获取氧浓度值和气道压值 
输入参数:   none
输出参数:   none
返 回 值:   none
创建日期:   2015-09-10
注    意:   none
*******************************************************************************
*/
static void DISPLAY_GETValue(void)
{
    m_DiFiO2Value = MONITOR_GetFiO2Value();
    m_DiPawValue = MONITOR_GetPawValue();
}
/*
********************************************************************************
********************************************************************************
*                               接口函数
********************************************************************************
********************************************************************************
*/
/*
******************************************************************************
函数名称:   DISPLAY_Doing
函数功能:   显示任务 
输入参数:   none
输出参数:   none
返 回 值:   none
创建日期:   2015-09-10
注    意:   none
*******************************************************************************
*/
void DISPLAY_Exec(void)
{   
    DISPLAY_GETValue();

    /*      在开机完成前或进入关机状态后或氧电池出错情况下不进行显示     */
    if((SHUTDOWN_Is() == DEF_SHUTDOWN_OFF) && (STARTINGUP_GetFlag() == DEF_STARTUP_ON) && (STARTINGUP_FiO2ErrorFlag() == DEF_STARTUP_OFF))
    {
        /*      校准或报警限值设置过程中，设置一个标志     */
        if(CALIBRATION_IsAdj() != 0)
        {
            m_DiAdjFlag = DEF_CAL_ON;
        }
        /*      非校准和报警限值设置过程中再显示数据的值        */
        else
        {
            /*      从校准模式退出来，重新刷一遍Oled屏     */
            if(m_DiAdjFlag == DEF_CAL_ON)
            {
                m_DiAdjFlag = DEF_CAL_OFF;
                OLED_Display(m_DiFiO2Value);
            }
            /*      当氧浓度值发生改变时，再刷屏      */
            else if(m_DiFiO2Valueflag != m_DiFiO2Value)
            {
                
                m_DiFiO2Valueflag = m_DiFiO2Value;
                OLED_Display(m_DiFiO2Value);
            }
            
            /*      当显示版本号后，OLED会在自检完成后刷新一遍     */
            else if((0 == m_DiOneFlag) && (1 == MONITOR_Version()))
            {
                m_DiOneFlag = 1;
                LCD_Clear();
                OLED_Display(m_DiFiO2Value);
            }
            PAW_LedSet(m_DiPawValue); 
        }
    }
}
/*
******************************************************************************
函数名称:   DISPLAY_GetFiO2
函数功能:   获得氧浓度显示值 
输入参数:   none
输出参数:   none
返 回 值:   none
创建日期:   2015-09-10
注    意:   none
*******************************************************************************
*/
INT8U DISPLAY_GetFiO2(void)
{
    return m_DiFiO2Value;
}
/*
******************************************************************************
函数名称:   DISPLAY_GetPaw
函数功能:   获得气道压显示值
输入参数:   none
输出参数:   none
返 回 值:   none
创建日期:   2015-09-10
注    意:   none
*******************************************************************************
*/
INT8U DISPLAY_GetPaw(void)
{
    return m_DiPawValue;
}
